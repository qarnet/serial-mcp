## CMakeLists.txt
```
cmake_minimum_required(VERSION 3.20.0)
find_package(Zephyr REQUIRED HINTS $ENV{ZEPHYR_BASE})
project(serial-mcp-test-fw)

target_include_directories(app PRIVATE src)
target_compile_definitions(app PRIVATE _GNU_SOURCE)

FILE(GLOB app_sources src/*.c)
target_sources(app PRIVATE ${app_sources})

# Keep native_simulator host-side build warnings quiet.
#
# The native_simulator runner is built by a separate GNU Makefile in
# scripts/native_simulator/Makefile. It reads nsi_config generated from the
# `native_simulator` INTERFACE target properties in natsim_config.cmake.
#
# The NixOS GCC wrapper unconditionally adds -D_FORTIFY_SOURCE=3. The NSI
# Makefile defaults to NSI_OPT=-O0 for debugging, so glibc emits a warning for
# each host-side source unless an optimization flag is present. Append -O2
# after NSI_OPT so the last -O flag wins and fortify is satisfied.
#
# The 32-bit (-m32) runner link scans default 64-bit library paths first and
# skips those entries before finding the 32-bit libraries. Suppress that
# cosmetic linker warning with --no-warn-search-mismatch; the correct
# 32-bit libraries are still linked.
if(NOT CONFIG_64BIT)
  target_compile_options(native_simulator INTERFACE -O2)
  target_link_options(native_simulator INTERFACE -Wl,--no-warn-search-mismatch)
endif()
```

## prj.conf
```kconfig
# SPDX-License-Identifier: MIT
#
# Kconfig for the native_sim test firmware.
#
# Enable serial support, interrupt-driven UART, line control, and ring buffering.
CONFIG_SERIAL=y
CONFIG_UART_INTERRUPT_DRIVEN=y
CONFIG_UART_LINE_CTRL=y
CONFIG_RING_BUFFER=y

# Provide hardware and build information for the `info` command.
CONFIG_HWINFO=y

# Send logs to the system logger instead of the command channel.
CONFIG_LOG=y

# Keep Zephyr shell traffic off the UART.
# boards/native_sim.conf sets CONFIG_CONSOLE=y because native_sim's
# POSIX_ARCH_CONSOLE requires it.
CONFIG_UART_CONSOLE=n
```

## boards/native_sim.conf
```kconfig
# SPDX-License-Identifier: MIT
#
# Kconfig fragment for the native_sim board.
# west build -b native_sim firmware/ applies this fragment automatically.
#
# The board provides the chosen Zephyr console and auto-enables
# CONFIG_UART_NATIVE_PTY because that console uses the
# "zephyr,native-pty-uart" compatible. This file selects the PTY mode for
# automated testing and disables console features that could steal command
# channel bytes.

# Connect the chosen console UART to its own dedicated pseudo-terminal
# (default). NativeSimFirmware::spawn reads the
# "uart connected to pseudotty: /dev/pts/N" line from stdout to find the
# PTY path. ON_OWN_PTY keeps logs and the command channel on separate streams.
CONFIG_UART_NATIVE_PTY_0_ON_OWN_PTY=y

# Prevent Kconfig.defconfig from auto-enabling UART_CONSOLE when both
# CONSOLE=y and SERIAL=y. The Zephyr console must not use the command UART,
# because it would emit prompts and consume command bytes.
# prj.conf disables UART_CONSOLE and leaves CONSOLE unset. The native_sim
# board unconditionally selects POSIX_ARCH_CONSOLE, which requires CONSOLE=y,
# so set it here. POSIX_ARCH_CONSOLE sends printk output to the host terminal,
# not the PTY, and does not interfere with the command channel.
CONFIG_CONSOLE=y

# Keep UART_CONSOLE off so the Zephyr shell cannot use the PTY or steal
# command-channel bytes.
CONFIG_UART_CONSOLE=n
```

## boards/native_sim_usb.conf
```kconfig
# SPDX-License-Identifier: MIT
#
# Kconfig fragment for native_sim + USB CDC-ACM (1200-baud touch test).
# Uses the LEGACY USB device stack because the device-next stack has no
# UDC driver for native_sim (only legacy USB_NATIVE_POSIX exists).
#
# Applied by the "usb" snippet (snippets/usb/snippet.yml):
#   west build -b native_sim firmware/ -d build/native_sim_usb --pristine -S usb

# Enable legacy USB device stack (not device-next — no native_sim UDC driver).
CONFIG_USB_DEVICE_STACK=y

# CDC-ACM class driver (auto-enabled by devicetree node, explicit here for clarity).
CONFIG_USB_CDC_ACM=y

# Enable baud rate change callback (legacy API) for 1200-baud touch detection.
CONFIG_CDC_ACM_DTE_RATE_CALLBACK_SUPPORT=y

# Don't auto-init USB at boot — our usb_cdc_init() handles it.
CONFIG_USB_DEVICE_INITIALIZE_AT_BOOT=n

# Quieter logs.
CONFIG_USB_DRIVER_LOG_LEVEL_ERR=y
CONFIG_USB_DEVICE_LOG_LEVEL_ERR=y
```

## boards/xiao_ble.conf
```kconfig
# SPDX-License-Identifier: MIT
#
# Kconfig fragments for the XIAO BLE nRF52840 board.
# Applied with: west build -b xiao_ble firmware/
#
# Build the application to live AFTER the Adafruit UF2 bootloader
# + SoftDevice s140 (which occupy 0x0 - 0x27000).

# Produce a .uf2 for drag-drop flashing after entering UF2 mode.
CONFIG_BUILD_OUTPUT_UF2=y

# Honour the partition layout defined in firmware/pm_static.yml.
# Without this, the board default puts the app at 0x0 and overwrites
# the bootloader.
CONFIG_USE_DT_CODE_PARTITION=y

# We are NOT using MCUboot. The Adafruit UF2 bootloader is pre-flashed
# at 0x0.
CONFIG_BOOTLOADER_MCUBOOT=n

# Allow direct GPIO access for any future commands that need it.
CONFIG_GPIO=y
```

## boards/xiao_ble_usb.conf
```kconfig
# SPDX-License-Identifier: MIT
#
# Kconfig fragment for xiao_ble + USB CDC-ACM (1200-baud touch via native USB).
# Applied with:
#   west build -b xiao_ble firmware/ \
#     -- -DEXTRA_CONF_FILE=boards/xiao_ble_usb.conf \
#        -DEXTRA_DTC_OVERLAY_FILE=boards/xiao_ble_usb.overlay
#
# The xiao_ble board's common DTSI (boards/seeed/xiao_ble/xiao_ble_common.dtsi)
# already includes cdc_acm_serial.dtsi which creates a board_cdc_acm_uart
# node on the nordic,nrf-usbd controller. The nRF USBD driver is
# auto-selected by DTS.
#
# This file just enables the new USB device stack + CDC-ACM class.
# The CDC-ACM UART is for 1200-baud touch ONLY — it must NOT be the
# console (commands go over the physical uart0). The overlay overrides
# zephyr,console to keep the physical uart0 as the command channel.

# Use the new USB device stack (device-next API).
CONFIG_USB_DEVICE_STACK_NEXT=y

# CDC-ACM class implementation (device-next variant).
CONFIG_USBD_CDC_ACM_CLASS=y

# Don't auto-initialize a serial console on the CDC UART at boot.
CONFIG_CDC_ACM_SERIAL_INITIALIZE_AT_BOOT=n

# Quieter logs for the USB subsystem.
CONFIG_USBD_LOG_LEVEL_ERR=y
CONFIG_UDC_DRIVER_LOG_LEVEL_ERR=y
CONFIG_USBD_CDC_ACM_LOG_LEVEL_OFF=y
```

## boards/native_sim_usb.overlay
```dts
/*
 * SPDX-License-Identifier: MIT
 *
 * Add a CDC-ACM UART node to native_sim's zephyr_udc0.
 * The board's zephyr_udc0 (zephyr,native-posix-udc) is already declared;
 * this overlay just attaches the CDC class instance to it.
 *
 * The CDC-ACM node's compatible is "zephyr,cdc-acm-uart" which the
 * USBD_CDC_ACM_CLASS driver binds to. usb_cdc.c uses
 * usbd_register_class(&ctx, "cdc_acm_0") to bind to the instance by name.
 */

&zephyr_udc0 {
	cdc_acm_0: cdc_acm_0 {
		compatible = "zephyr,cdc-acm-uart";
		label = "serial-mcp CDC-ACM";
	};
};
```

## boards/xiao_ble_usb.overlay
```dts
/*
 * SPDX-License-Identifier: MIT
 *
 * USB CDC-ACM overlay for xiao_ble.
 *
 * The xiao_ble board's common DTSI already includes cdc_acm_serial.dtsi
 * which:
 *   - creates a `board_cdc_acm_uart` node on zephyr_udc0
 *   - sets zephyr,console = &board_cdc_acm_uart
 *
 * We override zephyr,console back to &uart0 (the physical UART) because
 * the command channel must go through the physical UART (PicoProbe →
 * /dev/ttyACM0), not the USB CDC-ACM port. The CDC-ACM port is for the
 * 1200-baud touch ONLY.
 */

/ {
	chosen {
		zephyr,console = &uart0;
		zephyr,shell-uart = &uart0;
		zephyr,uart-mcumgr = &uart0;
	};
};
```

## src/main.c
```c
/*
 * Copyright (c) 2025 serial-mcp contributors
 * SPDX-License-Identifier: MIT
 *
 * Main entry point for serial-mcp test firmware.
 *
 * Runs on the Zephyr `native_sim` POSIX emulator. The command channel uses
 * the PTY-backed UART selected by DT_CHOSEN(zephyr_console). native_sim
 * prints the PTY path to stdout at boot so the host can open it through
 * serial-mcp's `open` tool.
 *
 * The `touch` command exits with status 42 for the bootloader-entry test.
 */

#include "command.h"
#include "uart_drv.h"

#include <errno.h>
#include <zephyr/kernel.h>
#include <zephyr/logging/log.h>

LOG_MODULE_REGISTER(main, LOG_LEVEL_INF);

static struct uart_drv uart0;
static struct app_state app;

int main(void)
{
	int ret;

	ret = uart_drv_init(&uart0);
	if (ret != 0) {
		LOG_ERR("UART driver init failed: %d", ret);
		return 0;
	}

	command_init(&app, &uart0);

	uart_drv_send_str(&uart0, "serial-mcp test firmware ready\r\n");

	char cmd_buf[UART_CMD_BUF_SIZE];

	while (1) {
		command_poll(&app);

		int len = uart_drv_get_cmd(&uart0, cmd_buf, sizeof(cmd_buf));
		if (len >= 0) {
			command_process(&app, cmd_buf);
		} else {
			k_msleep(1);
		}
	}

	return 0;
}
```

## src/command.c
```c
/*
 * Copyright (c) 2025 serial-mcp contributors
 * SPDX-License-Identifier: MIT
 *
 * Command parser and executor for serial-mcp test firmware.
 *
 * Supported commands:
 *   ping: return pong as a health response.
 *   spam <count> hex [last_data=".."] [delay=<ms>]: send a hex payload.
 *   spam stop: stop transmission and report bytes sent.
 *   info: report board and build information.
 *   rxbuf status|clear: inspect or clear the partial-line buffer.
 *   arm_cmd <delay_ms>: delay the next command.
 *   trace on|off: report received bytes with sequence numbers.
 *   framing on|off: report committed input lines.
 *   slow on [<us>]|off: delay command consumption.
 *   write cmd <id> <rest...>: execute a tagged nested command.
 *   binary on|off: enable or disable binary trace mode.
 *   txbuf status: report TX ring-buffer occupancy.
 *   ack on|off: enable or disable pre-execution acknowledgements.
 *   hold on|off: pause or resume firmware TX draining.
 *   touch: exit with status 42 for the bootloader-entry lifecycle test.
 *   jsonout: send JSON lines for parser tests.
 *   sendraw hex|text <data>: send raw payload without framing.
 */

#include "command.h"
#include <zephyr/kernel.h>
#include <zephyr/logging/log.h>
#include <string.h>
#include <stdlib.h>
#include <stdio.h>

LOG_MODULE_REGISTER(command, LOG_LEVEL_INF);

#define HEX_CHARS "0123456789abcdef"

static uint32_t xorshift32(uint32_t *state)
{
	uint32_t x = *state;
	x ^= x << 13;
	x ^= x >> 17;
	x ^= x << 5;
	*state = x;
	return x;
}

static void spam_timer_cb(struct k_timer *timer)
{
	struct spam_ctx *spam = CONTAINER_OF(timer, struct spam_ctx, timer);

	if (!spam->active || spam->stopping) {
		k_timer_stop(timer);
		return;
	}

	if (spam->remaining == 0) {
		spam->stopping = true;
		k_timer_stop(timer);
		uart_drv_printf(spam->drv, "Spam complete: %u bytes sent\r\n",
				 spam->total_bytes);
		spam->active = false;
		return;
	}

	uint8_t pkt[256];
	uint32_t pkt_len = (spam->remaining < sizeof(pkt)) ?
			   spam->remaining : sizeof(pkt);

	for (uint32_t i = 0; i < pkt_len; i++) {
		uint32_t v = xorshift32(&spam->xorshift_state);
		pkt[i] = HEX_CHARS[v & 0x0f];
	}

	uart_drv_send(spam->drv, pkt, pkt_len);
	spam->total_bytes += pkt_len;
	spam->remaining -= pkt_len;

	if (spam->remaining == 0) {
		if (spam->last_data_len > 0) {
			uart_drv_send(spam->drv, spam->last_data,
				      spam->last_data_len);
			spam->total_bytes += spam->last_data_len;
		}
		spam->stopping = true;
		k_timer_stop(timer);
		uart_drv_printf(spam->drv, "Spam complete: %u bytes sent\r\n",
				 spam->total_bytes);
		spam->active = false;
	}
}

static void cmd_sendraw(struct app_state *state, char *args)
{
	char *saveptr = NULL;
	char *mode = strtok_r(args, " ", &saveptr);
	char *data;

	if (!mode || *mode == '\0') {
		uart_drv_send_str(state->uart,
				  "ERR usage: sendraw hex|text <data>\r\n");
		return;
	}

	if (strcmp(mode, "hex") == 0) {
		data = strtok_r(NULL, "", &saveptr);
		if (!data) {
			uart_drv_send_str(state->uart,
					  "ERR usage: sendraw hex <hexdata>\r\n");
			return;
		}
		uint8_t byte;
		char pair[3] = {0};
		while (*data) {
			while (*data == ' ')
				data++;
			if (!*data || !data[1])
				break;
			pair[0] = data[0];
			pair[1] = data[1];
			byte = (uint8_t)strtoul(pair, NULL, 16);
			uart_drv_send(state->uart, &byte, 1);
			data += 2;
		}
	} else if (strcmp(mode, "text") == 0) {
		data = strtok_r(NULL, "", &saveptr);
		if (!data) {
			data = "";
		}
		uart_drv_send_str(state->uart, data);
		/* Send raw text without appending a line terminator. */
	} else {
		uart_drv_send_str(state->uart,
				  "ERR usage: sendraw hex|text <data>\r\n");
	}
}

static void cmd_ping(struct app_state *state)
{
	uart_drv_send_str(state->uart, "pong\r\n");
}

static void cmd_info(struct app_state *state)
{
	uart_drv_printf(state->uart,
		"board=native_sim build=0.1.0 " __DATE__ " " __TIME__ "\r\n");
}

static void cmd_spam_start(struct app_state *state, char *count_str, char *rest)
{
	if (state->spam.active) {
		uart_drv_send_str(state->uart, "ERR spam already active\r\n");
		return;
	}

	uint32_t count = (uint32_t)strtoul(count_str, NULL, 10);

	char *tok = strtok(rest, " ");
	if (!tok || strcmp(tok, "hex") != 0) {
		uart_drv_send_str(state->uart, "ERR only hex mode supported\r\n");
		return;
	}

	state->spam.total_bytes = 0;
	state->spam.remaining = count;
	state->spam.delay_ms = 10;
	state->spam.last_data_len = 0;
	state->spam.stopping = false;
	state->spam.xorshift_state = 0x12345678;

	while ((tok = strtok(NULL, " ")) != NULL) {
		if (strncmp(tok, "delay=", 6) == 0) {
			state->spam.delay_ms =
				(uint16_t)strtoul(tok + 6, NULL, 10);
		} else if (strncmp(tok, "last_data=", 10) == 0) {
			char *val = tok + 10;
			size_t vlen = strlen(val);
			if (vlen > 0 && val[0] == '"') {
				val++;
				vlen--;
			}
			if (vlen > 0 && val[vlen - 1] == '"') {
				vlen--;
			}
			if (vlen > sizeof(state->spam.last_data)) {
				vlen = sizeof(state->spam.last_data);
			}
			memcpy(state->spam.last_data, val, vlen);
			state->spam.last_data_len = (uint8_t)vlen;
		}
	}

	state->spam.active = true;
	state->spam.drv = state->uart;
	k_timer_init(&state->spam.timer, spam_timer_cb, NULL);
	k_timer_start(&state->spam.timer, K_MSEC(state->spam.delay_ms),
		       K_MSEC(state->spam.delay_ms));

	uart_drv_printf(state->uart, "spam start count=%u delay=%u\r\n",
			 count, state->spam.delay_ms);
}

static void cmd_spam_stop(struct app_state *state)
{
	if (!state->spam.active) {
		uart_drv_send_str(state->uart, "ERR no spam active\r\n");
		return;
	}

	state->spam.stopping = true;
	k_timer_stop(&state->spam.timer);
	state->spam.active = false;
	uart_drv_tx_clear(state->uart);
	uart_drv_printf(state->uart, "Spam stopped: %u bytes sent\r\n",
			 state->spam.total_bytes);
}

static void cmd_rxbuf_status(struct app_state *state)
{
	struct uart_drv *drv = state->uart;
	unsigned int key = irq_lock();
	uint16_t len = drv->cmd_len;
	char tmp[UART_CMD_BUF_SIZE];
	memcpy(tmp, drv->cmd_buf, len);
	irq_unlock(key);

	tmp[len] = '\0';
	uart_drv_printf(state->uart, "rxbuf len=%u data=\"", len);
	uart_drv_send(state->uart, tmp, len);
	uart_drv_send_str(state->uart, "\"\r\n");
}

static void cmd_rxbuf_clear(struct app_state *state)
{
	struct uart_drv *drv = state->uart;
	unsigned int key = irq_lock();
	uint16_t old_len = drv->cmd_len;
	drv->cmd_len = 0;
	drv->cmd_ready = false;
	irq_unlock(key);

	uart_drv_printf(state->uart, "rxbuf clear was_len=%u\r\n", old_len);
}

static void cmd_arm(struct app_state *state, char *delay_str)
{
	if (!delay_str || *delay_str == '\0') {
		uart_drv_send_str(state->uart, "ERR usage: arm_cmd <delay_ms>\r\n");
		return;
	}

	state->arm_delay_ms = (uint32_t)strtoul(delay_str, NULL, 10);
	state->arm_active = true;
	uart_drv_printf(state->uart, "arm_cmd delay=%u\r\n",
			 state->arm_delay_ms);
}

static void cmd_trace(struct app_state *state, char *arg)
{
	if (!arg || *arg == '\0') {
		uart_drv_send_str(state->uart, "ERR usage: trace on|off\r\n");
		return;
	}

	if (strcmp(arg, "on") == 0) {
		state->uart->trace_on = true;
		state->uart->rx_seq = 0;
		uart_drv_send_str(state->uart, "trace on\r\n");
	} else if (strcmp(arg, "off") == 0) {
		state->uart->trace_on = false;
		uart_drv_send_str(state->uart, "trace off\r\n");
	} else {
		uart_drv_send_str(state->uart, "ERR usage: trace on|off\r\n");
	}
}

static void cmd_framing(struct app_state *state, char *arg)
{
	if (!arg || *arg == '\0') {
		uart_drv_send_str(state->uart, "ERR usage: framing on|off\r\n");
		return;
	}

	if (strcmp(arg, "on") == 0) {
		state->uart->framing_on = true;
		uart_drv_send_str(state->uart, "framing on\r\n");
	} else if (strcmp(arg, "off") == 0) {
		state->uart->framing_on = false;
		uart_drv_send_str(state->uart, "framing off\r\n");
	} else {
		uart_drv_send_str(state->uart, "ERR usage: framing on|off\r\n");
	}
}

static void cmd_slow(struct app_state *state, char *arg)
{
	if (!arg || *arg == '\0') {
		uart_drv_send_str(state->uart, "ERR usage: slow on [<us>] | slow off\r\n");
		return;
	}

	if (strcmp(arg, "on") == 0) {
		state->slow_delay_us = 50000;
		state->slow_mode = true;
		uart_drv_printf(state->uart, "slow on delay=%u\r\n",
				 state->slow_delay_us);
	} else if (strncmp(arg, "on ", 3) == 0) {
		state->slow_delay_us = (uint32_t)strtoul(arg + 3, NULL, 10);
		state->slow_mode = true;
		uart_drv_printf(state->uart, "slow on delay=%u\r\n",
				 state->slow_delay_us);
	} else if (strcmp(arg, "off") == 0) {
		state->slow_mode = false;
		uart_drv_send_str(state->uart, "slow off\r\n");
	} else {
		uart_drv_send_str(state->uart, "ERR usage: slow on [<us>] | slow off\r\n");
	}
}

static void cmd_write(struct app_state *state, char *args)
{
	char *saveptr2 = NULL;
	char *sub = strtok_r(args, " ", &saveptr2);
	if (!sub || strcmp(sub, "cmd") != 0) {
		uart_drv_send_str(state->uart, "ERR usage: write cmd <id> <command...>\r\n");
		return;
	}

	char *id_str = strtok_r(NULL, " ", &saveptr2);
	if (!id_str) {
		uart_drv_send_str(state->uart, "ERR missing command id\r\n");
		return;
	}

	uint32_t cmd_id = (uint32_t)strtoul(id_str, NULL, 10);
	char *rest = strtok_r(NULL, "", &saveptr2);
	if (!rest) {
		uart_drv_send_str(state->uart, "ERR missing command body\r\n");
		return;
	}

	uart_drv_printf(state->uart, "ack %u exec>%s\r\n", cmd_id, rest);

	command_process(state, rest);
}

static void cmd_binary(struct app_state *state, char *arg)
{
	if (!arg || *arg == '\0') {
		uart_drv_send_str(state->uart, "ERR usage: binary on|off\r\n");
		return;
	}

	if (strcmp(arg, "on") == 0) {
		state->binary_mode = true;
		state->uart->trace_on = true;
		state->uart->rx_seq = 0;
		uart_drv_send_str(state->uart, "binary on\r\n");
	} else if (strcmp(arg, "off") == 0) {
		state->binary_mode = false;
		uart_drv_send_str(state->uart, "binary off\r\n");
	} else {
		uart_drv_send_str(state->uart, "ERR usage: binary on|off\r\n");
	}
}

static void cmd_txbuf_status(struct app_state *state)
{
	struct uart_drv *drv = state->uart;
	unsigned int key = irq_lock();
	uint32_t len = ring_buf_size_get(&drv->tx_ringbuf);
	bool busy = drv->tx_busy;
	irq_unlock(key);

	uart_drv_printf(state->uart, "txbuf len=%u busy=%u\r\n", len, busy);
}

static void cmd_ack(struct app_state *state, char *arg)
{
	if (!arg || *arg == '\0') {
		uart_drv_send_str(state->uart, "ERR usage: ack on|off\r\n");
		return;
	}

	if (strcmp(arg, "on") == 0) {
		state->ack_enabled = true;
		state->ack_seq = 0;
		uart_drv_send_str(state->uart, "ack on\r\n");
	} else if (strcmp(arg, "off") == 0) {
		state->ack_enabled = false;
		uart_drv_send_str(state->uart, "ack off\r\n");
	} else {
		uart_drv_send_str(state->uart, "ERR usage: ack on|off\r\n");
	}
}

static void cmd_hold(struct app_state *state, char *arg)
{
	if (!arg || *arg == '\0') {
		uart_drv_send_str(state->uart, "ERR usage: hold on|off\r\n");
		return;
	}

	if (strcmp(arg, "on") == 0) {
		uart_drv_send_str(state->uart, "hold on\r\n");
		state->uart->tx_hold = true;
	} else if (strcmp(arg, "off") == 0) {
		uart_drv_send_str(state->uart, "hold off\r\n");
		state->uart->tx_hold = false;
		/* Re-enable TX interrupts so pending data can drain. */
		uart_irq_tx_enable(state->uart->dev);
	} else {
		uart_drv_send_str(state->uart, "ERR usage: hold on|off\r\n");
	}
}

static void cmd_jsonout(struct app_state *state)
{
	/* Send complete JSON objects with CRLF terminators for parser tests. */
	uart_drv_printf(state->uart,
			"{\"sensor\":\"temp\",\"value\":25.5,\"unit\":\"C\"}\r\n");
	uart_drv_printf(state->uart,
			"{\"sensor\":\"humidity\",\"value\":60,\"unit\":\"%%\"}\r\n");
	uart_drv_printf(state->uart,
			"{\"sensor\":\"pressure\",\"value\":1013.25,\"unit\":\"hPa\"}\r\n");
}

void command_init(struct app_state *state, struct uart_drv *drv)
{
	memset(state, 0, sizeof(*state));
	state->uart = drv;
	state->slow_delay_us = 50000;
	state->spam.drv = drv;
}

void command_process(struct app_state *state, char *line)
{
	char *saveptr = NULL;
	char *cmd = strtok_r(line, " ", &saveptr);

	if (!cmd) {
		return;
	}

	if (state->arm_active) {
		uint32_t delay = state->arm_delay_ms;
		state->arm_active = false;
		k_msleep(delay);
	}

	if (state->slow_mode) {
		k_usleep(state->slow_delay_us);
	}

	if (state->ack_enabled) {
		uart_drv_printf(state->uart, "ack %u\r\n", state->ack_seq++);
	}

	if (strcmp(cmd, "ping") == 0) {
		cmd_ping(state);
	} else if (strcmp(cmd, "spam") == 0) {
		char *sub = strtok_r(NULL, " ", &saveptr);
		if (sub && strcmp(sub, "stop") == 0) {
			cmd_spam_stop(state);
		} else if (sub) {
			cmd_spam_start(state, sub, saveptr);
		} else {
			uart_drv_send_str(state->uart, "ERR usage: spam <count> hex [last_data=\"..\"] [delay=<ms>]\r\n");
		}
	} else if (strcmp(cmd, "info") == 0) {
		cmd_info(state);
	} else if (strcmp(cmd, "rxbuf") == 0) {
		char *sub = strtok_r(NULL, " ", &saveptr);
		if (sub && strcmp(sub, "status") == 0) {
			cmd_rxbuf_status(state);
		} else if (sub && strcmp(sub, "clear") == 0) {
			cmd_rxbuf_clear(state);
		} else {
			uart_drv_send_str(state->uart, "ERR usage: rxbuf status|clear\r\n");
		}
	} else if (strcmp(cmd, "arm_cmd") == 0) {
		cmd_arm(state, saveptr ? saveptr : "");
	} else if (strcmp(cmd, "trace") == 0) {
		cmd_trace(state, saveptr ? saveptr : "");
	} else if (strcmp(cmd, "framing") == 0) {
		cmd_framing(state, saveptr ? saveptr : "");
	} else if (strcmp(cmd, "slow") == 0) {
		cmd_slow(state, saveptr ? saveptr : "");
	} else if (strcmp(cmd, "write") == 0) {
		cmd_write(state, saveptr ? saveptr : "");
	} else if (strcmp(cmd, "binary") == 0) {
		cmd_binary(state, saveptr ? saveptr : "");
	} else if (strcmp(cmd, "txbuf") == 0) {
		char *sub = strtok_r(NULL, " ", &saveptr);
		if (sub && strcmp(sub, "status") == 0) {
			cmd_txbuf_status(state);
		} else {
			uart_drv_send_str(state->uart, "ERR usage: txbuf status\r\n");
		}
	} else if (strcmp(cmd, "ack") == 0) {
		cmd_ack(state, saveptr ? saveptr : "");
	} else if (strcmp(cmd, "hold") == 0) {
		cmd_hold(state, saveptr ? saveptr : "");
	} else if (strcmp(cmd, "touch") == 0) {
		uart_drv_send_str(state->uart, "touch exit(42)\r\n");
		exit(42);
	} else if (strcmp(cmd, "jsonout") == 0) {
		cmd_jsonout(state);
	} else if (strcmp(cmd, "sendraw") == 0) {
		cmd_sendraw(state, saveptr ? saveptr : "");
	} else {
		uart_drv_printf(state->uart, "ERR unknown command: %s\r\n", cmd);
	}
}

void command_poll(struct app_state *state)
{
	if (state->spam.active && state->spam.stopping) {
		state->spam.active = false;
	}
}
```

## src/command.h
```c
#ifndef COMMAND_H_
#define COMMAND_H_

#include "uart_drv.h"

struct spam_ctx {
	bool active;
	bool stopping;
	uint32_t total_bytes;
	uint32_t remaining;
	uint16_t delay_ms;
	uint8_t last_data[4];
	uint8_t last_data_len;
	uint32_t xorshift_state;
	struct k_timer timer;
	struct uart_drv *drv;
};

struct app_state {
	struct uart_drv *uart;
	struct spam_ctx spam;

	bool arm_active;
	uint32_t arm_delay_ms;

	bool slow_mode;
	uint32_t slow_delay_us;

	bool cmd_id_enabled;
	uint32_t next_cmd_id;

	bool binary_mode;

	bool ack_enabled;
	uint32_t ack_seq;
};

void command_init(struct app_state *state, struct uart_drv *drv);
void command_process(struct app_state *state, char *line);
void command_poll(struct app_state *state);

#endif
```

## src/uart_drv.c
```c
/*
 * Copyright (c) 2025 serial-mcp contributors
 * SPDX-License-Identifier: MIT
 *
 * UART driver with line-buffered RX and ring-buffered TX.
 */

#include "uart_drv.h"
#include <zephyr/kernel.h>
#include <zephyr/logging/log.h>
#include <stdio.h>
#include <string.h>
#include <stdarg.h>

LOG_MODULE_REGISTER(uart_drv, LOG_LEVEL_INF);

static void uart_isr(const struct device *dev, void *user_data)
{
	struct uart_drv *drv = (struct uart_drv *)user_data;

	while (uart_irq_update(dev) && uart_irq_is_pending(dev)) {
		if (!drv->rx_throttled && uart_irq_rx_ready(dev)) {
			uint8_t byte;
			while (uart_fifo_read(dev, &byte, 1) == 1) {
				if (drv->trace_on) {
					uart_drv_printf(drv, "RX[%u]=0x%02x\r\n",
							drv->rx_seq, byte);
					drv->rx_seq++;
				}

				if (drv->cmd_len < UART_CMD_BUF_SIZE - 1) {
					if (byte == '\r' || byte == '\n') {
						if (drv->cmd_len > 0) {
							drv->cmd_buf[drv->cmd_len] = '\0';
							drv->cmd_ready = true;
							if (drv->framing_on) {
								uart_drv_printf(drv,
									"LINE len=%u data=\"%s\"\r\n",
									drv->cmd_len,
									drv->cmd_buf);
							}
						}
					} else {
						drv->cmd_buf[drv->cmd_len++] = byte;
					}
				} else {
					drv->cmd_buf[drv->cmd_len] = '\0';
					drv->cmd_ready = true;
				}
			}
		}

		if (uart_irq_tx_ready(dev)) {
			if (drv->tx_hold) {
				uart_irq_tx_disable(dev);
				drv->tx_busy = false;
				continue;
			}
			uint8_t tmp[64];
			int rb_len = (int)ring_buf_get(&drv->tx_ringbuf, tmp, sizeof(tmp));

			if (rb_len == 0) {
				uart_irq_tx_disable(dev);
				drv->tx_busy = false;
				continue;
			}

			int sent = uart_fifo_fill(dev, tmp, rb_len);
			if (sent < rb_len) {
				ring_buf_put(&drv->tx_ringbuf, tmp + sent,
					     rb_len - sent);
			}
		}
	}
}

int uart_drv_init(struct uart_drv *drv)
{
	memset(drv, 0, sizeof(*drv));
	drv->dev = DEVICE_DT_GET(DT_CHOSEN(zephyr_console));

	if (!device_is_ready(drv->dev)) {
		LOG_ERR("Console UART device not ready");
		return -ENODEV;
	}

	ring_buf_init(&drv->tx_ringbuf, sizeof(drv->tx_buf), drv->tx_buf);

	uart_irq_callback_user_data_set(drv->dev, uart_isr, drv);
	uart_irq_rx_enable(drv->dev);

	return 0;
}

void uart_drv_send(struct uart_drv *drv, const void *data, size_t len)
{
	if (len == 0) {
		return;
	}

	unsigned int key = irq_lock();
	size_t space = ring_buf_space_get(&drv->tx_ringbuf);
	size_t put_len = (len < space) ? len : space;
	ring_buf_put(&drv->tx_ringbuf, data, put_len);
	bool was_idle = !drv->tx_busy;
	drv->tx_busy = true;
	irq_unlock(key);

	if (put_len < len) {
		LOG_WRN("TX drop: %zu of %zu bytes", len - put_len, len);
	}

	if (was_idle) {
		uart_irq_tx_enable(drv->dev);
	}
}

void uart_drv_send_str(struct uart_drv *drv, const char *str)
{
	uart_drv_send(drv, str, strlen(str));
}

void uart_drv_printf(struct uart_drv *drv, const char *fmt, ...)
{
	char tmp[128];
	va_list ap;
	va_start(ap, fmt);
	int n = vsnprintk(tmp, sizeof(tmp), fmt, ap);
	va_end(ap);
	if (n > 0) {
		uart_drv_send(drv, tmp, (size_t)n);
	}
}

void uart_drv_tx_clear(struct uart_drv *drv)
{
	unsigned int key = irq_lock();
	ring_buf_reset(&drv->tx_ringbuf);
	drv->tx_busy = false;
	irq_unlock(key);
	uart_irq_tx_disable(drv->dev);
}

int uart_drv_get_cmd(struct uart_drv *drv, char *buf, size_t buf_size)
{
	if (!drv->cmd_ready) {
		return -1;
	}

	unsigned int key = irq_lock();
	size_t len = drv->cmd_len;
	if (len >= buf_size) {
		len = buf_size - 1;
	}
	memcpy(buf, drv->cmd_buf, len);
	buf[len] = '\0';
	drv->cmd_len = 0;
	drv->cmd_ready = false;
	irq_unlock(key);
	return (int)len;
}

const struct device *uart_drv_device(struct uart_drv *drv)
{
	return drv->dev;
}
```

## src/uart_drv.h
```c
#ifndef UART_DRV_H_
#define UART_DRV_H_

#include <zephyr/device.h>
#include <zephyr/drivers/uart.h>
#include <zephyr/sys/ring_buffer.h>
#include <zephyr/kernel.h>

#define UART_RX_BUF_SIZE 256
#define UART_TX_BUF_SIZE 4096
#define UART_CMD_BUF_SIZE 256

struct uart_drv {
	const struct device *dev;
	struct ring_buf tx_ringbuf;
	uint8_t tx_buf[UART_TX_BUF_SIZE];
	volatile bool tx_busy;
	volatile bool rx_throttled;

	uint8_t cmd_buf[UART_CMD_BUF_SIZE];
	uint16_t cmd_len;
	volatile bool cmd_ready;

	uint8_t rx_seq;
	bool trace_on;
	bool framing_on;
	bool tx_hold;
};

int uart_drv_init(struct uart_drv *drv);
void uart_drv_send(struct uart_drv *drv, const void *data, size_t len);
void uart_drv_send_str(struct uart_drv *drv, const char *str);
void uart_drv_printf(struct uart_drv *drv, const char *fmt, ...);
void uart_drv_tx_clear(struct uart_drv *drv);
int uart_drv_get_cmd(struct uart_drv *drv, char *buf, size_t buf_size);
const struct device *uart_drv_device(struct uart_drv *drv);

#endif
```

## src/usb_cdc.c
```c
/*
 * Copyright (c) 2025 serial-mcp contributors
 * SPDX-License-Identifier: MIT
 *
 * USB CDC-ACM device stack initialization + 1200-baud touch handler.
 *
 * Built for the native_sim POSIX emulator. Uses the legacy Zephyr
 * USB device stack because that is the only stack with
 * USB_NATIVE_POSIX / USB/IP support on native_sim.
 *
 * When the host opens the CDC-ACM port at 1200 baud and pulses DTR
 * (assert → de-assert), this module triggers bootloader entry:
 *   - writes 0x57 to a global, then exit(42) so the test
 *     process can verify the magic exit code.
 */

#include "usb_cdc.h"

#include <errno.h>
#include <stdlib.h>
#include <zephyr/logging/log.h>
#include <zephyr/devicetree.h>

LOG_MODULE_REGISTER(usb_cdc, LOG_LEVEL_INF);

#define GPREGRET_BOOTLOADER_MAGIC 0x57
#define TOUCH_BAUD_RATE 1200

/* Visible to tests: a global that the native_sim bootloader-entry
 * handler writes to. Tests can verify the magic value.
 *
 * Always defined so `usb_cdc_init()` callers (and any test code that
 * peeks at it) can link cleanly against the plain `native_sim` build.
 */
volatile uint8_t sim_gpregret;

#if defined(CONFIG_USB_DEVICE_STACK) && defined(CONFIG_USB_CDC_ACM) && DT_NODE_EXISTS(DT_NODELABEL(cdc_acm_0))

#include <zephyr/device.h>
#include <zephyr/drivers/uart.h>
#include <zephyr/drivers/uart/cdc_acm.h>
#include <zephyr/usb/usb_device.h>

static inline void do_bootloader_entry(void)
{
	sim_gpregret = GPREGRET_BOOTLOADER_MAGIC;
	LOG_INF("Bootloader entry: sim_gpregret=0x57, exit(42)");
	exit(42);
}

/* CDC-ACM UART node from our overlay (cdc_acm_0 on zephyr_udc0). */
#define CDC_DEV DEVICE_DT_GET(DT_NODELABEL(cdc_acm_0))

static uint32_t current_baud = 115200;
static bool dtr_prev_state;
static struct k_work_delayable dtr_poll_work;

/* Periodic DTR poll — the legacy CDC-ACM driver does not fire a callback
 * on DTR changes, so we sample uart_line_ctrl_get(UART_LINE_CTRL_DTR)
 * every 50 ms.
 */
static void dtr_poll_fn(struct k_work *work)
{
	uint32_t dtr = 0;

	if (uart_line_ctrl_get(CDC_DEV, UART_LINE_CTRL_DTR, &dtr) == 0) {
		bool dtr_high = (dtr != 0);

		if (dtr_prev_state && !dtr_high &&
		    current_baud == TOUCH_BAUD_RATE) {
			LOG_INF("1200-baud touch detected");
			do_bootloader_entry();
		}
		dtr_prev_state = dtr_high;
	}

	k_work_schedule(&dtr_poll_work, K_MSEC(50));
}

/* Baud rate change callback (CDC_ACM_DTE_RATE_CALLBACK_SUPPORT). */
static void baud_rate_cb(const struct device *dev, uint32_t rate)
{
	LOG_INF("CDC baud rate changed to %u", rate);
	current_baud = rate;
}

int usb_cdc_init(void)
{
	int err;

	if (!device_is_ready(CDC_DEV)) {
		LOG_ERR("CDC ACM device not ready");
		return -ENODEV;
	}

	cdc_acm_dte_rate_callback_set(CDC_DEV, baud_rate_cb);

	k_work_init_delayable(&dtr_poll_work, dtr_poll_fn);
	k_work_schedule(&dtr_poll_work, K_MSEC(100));

	/* Enable the USB device stack.  This triggers usb_dc_attach() on
	 * the native_posix controller, which starts the USB/IP server
	 * on port 3240.
	 */
	err = usb_enable(NULL);
	if (err) {
		LOG_ERR("Failed to enable USB device support: %d", err);
		return err;
	}

	LOG_INF("USB CDC-ACM ready");
	return 0;
}

#else /* !(CONFIG_USB_DEVICE_STACK && CONFIG_USB_CDC_ACM && cdc_acm_0 DT node) */

/* Plain `native_sim` build: no USB CDC support compiled in.
 * `usb_cdc_init()` returns -ENODEV so callers (see `main.c`) can
 * treat "USB not built" as a non-fatal condition.
 */
int usb_cdc_init(void)
{
	return -ENODEV;
}

#endif /* CONFIG_USB_DEVICE_STACK && CONFIG_USB_CDC_ACM && DT_NODE_EXISTS(cdc_acm_0) */
```

## src/usb_cdc.h
```c
/*
 * Copyright (c) 2025 serial-mcp contributors
 * SPDX-License-Identifier: MIT
 *
 * USB CDC-ACM support for the 1200-baud touch → bootloader entry flow
 * on the native_sim POSIX emulator.
 *
 * The CDC-ACM device is enabled by setting `CONFIG_USB_DEVICE_STACK=y`
 * in `boards/native_sim_usb.conf`. The companion CDC-ACM node is
 * declared in `boards/native_sim_usb.overlay`.
 */
#ifndef USB_CDC_H_
#define USB_CDC_H_

#include <zephyr/kernel.h>

/*
 * Initialize the USB device stack and register a CDC-ACM UART.
 *
 * The driver samples DTR every 50 ms and watches for the 1200-baud
 * touch sequence:
 *   1. Host opens CDC port at 1200 baud
 *   2. Host sets DTR (asserted)
 *   3. Host clears DTR (de-asserted) — the "touch"
 * When detected, the firmware writes `sim_gpregret = 0x57` and
 * calls `exit(42)` so the test process can verify the magic exit code.
 *
 * Returns 0 on success, negative errno on failure.
 */
int usb_cdc_init(void);

#endif /* USB_CDC_H_ */
```
